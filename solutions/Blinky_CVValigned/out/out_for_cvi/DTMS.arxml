AUTOSAR XML (schema 4-2-2)
package /DTMS
  data type mapping set DTMS_DataTypeMappingSet
    data-type-maps:
      application-data-type=adt_duty, implementation-data-type=idt_duty
      application-data-type=adt_voltage, implementation-data-type=idt_voltage
