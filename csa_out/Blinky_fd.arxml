AUTOSAR XML (schema 4-2-2)
package /DataType/DataTypeSemantics
  compu method dt_id_compu_meth_00002: texttable  # Identical conversion (Physical == Internal). Used by default if no other information
package /DataType/DataTypeMappingSet
  data type mapping set id_data_type_map_set_00003
package /VehicleConfiguration/Scs0
  sw systemconst root: compu {texttable}
package /ComponentType/CompositionSwComponentType
  composition sw component type RootComposition
package /System
  system Blinky_fd: category=SystemDescription, system-version=0.0.0; Export Project:blinky Design:Blinky_pf Revision:1 Bridge Export :125.d.02
    system mapping id_system_map_1000
    root-software-compositions:
      root sw composition prototype RootSwCompositionPrototype: software-composition=RootComposition
