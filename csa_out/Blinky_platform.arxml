AUTOSAR XML (schema 4-2-2)
package /DataType/DataTypeSemantics
  compu method dt_id_compu_meth_00002: texttable  # Identical conversion (Physical == Internal). Used by default if no other information
package /DataType/DataTypeMappingSet
  data type mapping set id_data_type_map_set_00003
package /VehicleConfiguration/Scs0
  sw systemconst root: compu {texttable}
package /ComponentType/CompositionSwComponentType
  composition sw component type RootComposition
package /VehicleTopology
  6 x can cluster, all with baudrate=0, protocol-name=CAN, protocol-version=0:
    Control2Driver
      can physical channel id_can_phys_chan_1000
    Driver_output
      can physical channel id_can_phys_chan_1001
    Ground_to_LED
      can physical channel id_can_phys_chan_1002
    PotOut
      can physical channel id_can_phys_chan_1003
    Power_to_ECU
      can physical channel id_can_phys_chan_1004
    Power_to_Pot
      can physical channel id_can_phys_chan_1005
package /System
  system Blinky_platform: category=SystemDescription, system-version=0.0.0; Export Project:blinky Design:Blinky_pf Revision:1 Bridge Export :125.d.02
    system mapping id_system_map_1006
    root-software-compositions:
      root sw composition prototype RootSwCompositionPrototype: software-composition=RootComposition
