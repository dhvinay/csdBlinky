AUTOSAR XML (schema 4-2-2)
# Copyright 2020 Siemens
# All rights reserved
# THIS WORK CONTAINS TRADE SECRET AND PROPRIETARY INFORMATION WHICH IS
# THE PROPERTY OF SIEMENS OR ITS LICENSORS AND IS SUBJECT TO LICENSE TERMS.
package /pkg_ecuc
  module config Os
    Rte_Ev_ComTask (OsEvent)
    ComTask (OsTask): OsTaskEventRef=Rte_Ev_ComTask
    Rte_Ev_ModeTask (OsEvent)
    ModeTask (OsTask): OsTaskEventRef=Rte_Ev_ModeTask
    Rte_Al_OsTask (OsAlarm): OsAlarmCounterRef=OsCounter
      OsAlarmAction
        OsAlarmActivateTask: OsAlarmActivateTaskRef=OsTask
    RES_SCHEDULER (OsResource)
